## main/Kconfig.projbuild
```kconfig
menu "FA_Control"

    comment "Seit v1.31 ein Image fuer alle Boards (Sockel, Board v7, JTAG-Piggyback)."
    comment "Das Board erkennt board.c beim Start, eine Build-Auswahl gibt es nicht mehr."

endmenu
```
